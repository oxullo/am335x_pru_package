/dts-v1/;
/plugin/;

/ {
    compatible = "ti,beaglebone", "ti,beaglebone-black";

    /* identification */
    part-number = "pru0_outputs";

    fragment@0 {
        target = <&am33xx_pinmux>;
        __overlay__ {
            pru0_output_pins: pru0_output_pins {
                pinctrl-single,pins = <
                    0x194 0x05  /* P9_29 to PRU output */
                    0x198 0x05  /* P9_30 to PRU output */
                >;
            };
        };
    };

    fragment@1 {
        target = <&pruss>;
        __overlay__ {
            status = "okay";
            pinctrl-names = "default";
            pinctrl-0 = <&pru0_output_pins>;
        };
    };
};

